#include <dt-bindings/zmk/matrix_transform.h>
#include "skeletyl.dtsi"

&default_transform {
	col-offset = <5>;
};

&kscan0 {
	col-gpios
		= <&pro_micro 19 GPIO_ACTIVE_HIGH>
		, <&pro_micro 20 GPIO_ACTIVE_HIGH>
		, <&pro_micro 10 GPIO_ACTIVE_HIGH>
		, <&pro_micro 6 GPIO_ACTIVE_HIGH>
		, <&pro_micro 7 GPIO_ACTIVE_HIGH>
		, <&pro_micro 8 GPIO_ACTIVE_HIGH>
		;
};
