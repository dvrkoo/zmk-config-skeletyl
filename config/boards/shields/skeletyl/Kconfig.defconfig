## config/boards/shields/skeletyl/Kconfig.defconfig
```kconfig
# if SHIELD_SKELETYL_LEFT
if SHIELD_SKELETYL_RIGHT
config ZMK_KEYBOARD_NAME
    default "skeletyl"

config ZMK_SPLIT_ROLE_CENTRAL
    default y

config ZMK_USB
	default y

endif

if SHIELD_SKELETYL_LEFT || SHIELD_SKELETYL_RIGHT

config ZMK_SPLIT
    default y

endif
  
```
